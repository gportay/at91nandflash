## Kconfig
```kconfig
#
# For a description of the syntax of this configuration file,
# see ./share/doc/kconfig-frontends/kconfig-language.txt.
#
mainmenu "AT91 Nandflash Configuration"

config CROSS_COMPILE
	string "Cross-compiler tool prefix"
	default "arm-linux-gnueabi-"
	help
	  Same as running 'make CROSS_COMPILE=prefix-' but stored for
	  default make runs in this kernel build directory.  You don't
	  need to set this unless you want the configured kernel build
	  directory to select the cross-compiler automatically.

menu "AT91Bootstrap"

config AT91DEFCONFIG
	string "AT91 Bootstrap defconfig"
	default ""
	help

endmenu

menu "InitRAMFS"

config INITRAMFS_DEFCONFIG
	string "InitRAMFS defconfig"
	default ""
	help

endmenu

menu "Linux"

config LINUXDIR
	string "Linux directory"
	default "linux"
	help

config KDEFCONFIG
	default "at91_dt_defconfig"
	help

endmenu

menu "UBI"

config UBI
	bool "Enable UBI"
	default y
	help

config UBI_SPARE
	bool "Enable spare volumes"
	depends on UBI
	default n
	help

config MKFSUBIFSOPTS
	string "mkubifs options"
	depends on UBI
	default "--leb-size 0x1f000 --min-io-size 0x800 --max-leb-cnt 2048"
	help

config UBINIZEOPTS
	string "ubinize options"
	depends on UBI
	default "--peb-size 0x20000 --min-io-size 0x800 --sub-page-size 0x800"
	help

config DTB
	bool "Enable Device-Tree Support"
	default y
	help

config DTB_UBI_VOLNAME
	string "Device-Tree Volume-name"
	depends on DTB && UBI
	default "dtb"

config DTB_SPARE_UBI_VOLNAME
	string "Device-Tree Spare Volume-name"
	depends on DTB && UBI && UBI_SPARE
	default "dtb-spare"

config KERNEL_UBI_VOLNAME
	string "Kernel Volume Name"
	depends on UBI
	default "kernel"
	help

config KERNEL_SPARE_UBI_VOLNAME
	string "Kernel Spare Volume Name"
	depends on UBI && UBI_SPARE
	default "kernel-spare"
	help

config PERSISTANT_UBI_VOLNAME
	string "Persitant Volume Name"
	depends on UBI
	default "persistant"
	help

config AUTORESIZEFLAG
	bool "Auto-resize Flag"
	depends on UBI
	default y
	help

endmenu
```
